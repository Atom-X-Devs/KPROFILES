// SPDX-License-Identifier: GPL-2.0
// Copyright (C) 2021 Atom-X-Devs < https://www.github.com/Atom-X-Devs >

&reserved_mem {
	ramoops {
		status = "ok";
		compatible = "removed-dma-pool", "ramoops";
		no-map;
		reg = <0x0 0xb0000000 0x0 0x00400000>;
		console-size = <0x200000>;
		pmsg-size = <0x200000>;
	};
};
