// SPDX-License-Identifier: GPL-2.0
// Copyright (C) 2021 Atom-X-Devs < https://www.github.com/Atom-X-Devs >

// asus X00TD camera changes
&cci {
	/delete-node/ qcom,eeprom@2;

	qcom,camera@0 {
		/delete-property/ qcom,special-support-sensors;
	};

	qcom,camera@2 {
		qcom,csiphy-sd-index = <1>;
		qcom,csid-sd-index = <1>;
		qcom,eeprom-src = <&eeprom0>;
		qcom,cam-vreg-min-voltage = <1780000 0 1224000>;
		pinctrl-0 = <&cam_sensor_mclk3_active
					&cam_sensor_rear2_active
					&cam_sensor_eldo4_default>;
		pinctrl-1 = <&cam_sensor_mclk3_suspend
					&cam_sensor_rear2_suspend>;
		gpios = <&tlmm 35 0>,
				<&tlmm 48 0>,
				<&pm660l_gpios 4 0>;
		qcom,gpio-req-tbl-label = "CAMIF_MCLK2",
					"CAM_RESET2",
					"CAM_VDIG2";
		qcom,sensor-position = <0>;
		clocks = <&clock_mmss MCLK3_CLK_SRC>,
			<&clock_mmss MMSS_CAMSS_MCLK3_CLK>;
	};
};

&eeprom1 {
	cam_vdig-supply = <&pm660_s5>;
	qcom,cam-vreg-min-voltage = <1780000 0 1224000>;
	qcom,cam-vreg-max-voltage = <1950000 0 1350000>;
	qcom,cam-vreg-op-mode = <105000 0 105000>;
	pinctrl-0 = <&cam_sensor_mclk1_active
				&cam_sensor_front_active
				&cam_sensor_eldo3_default>;
	pinctrl-1 = <&cam_sensor_mclk1_suspend
				&cam_sensor_front_suspend>;
	gpios = <&tlmm 33 0>,
			<&tlmm 47 0>,
			<&pm660l_gpios 3 0>;
	qcom,gpio-vdig = <2>;
	qcom,gpio-req-tbl-num = <0 1 2>;
	qcom,gpio-req-tbl-flags = <1 0 0>;
	qcom,gpio-req-tbl-label = "CAMIF_MCLK1",
				"CAM_RESET1",
				"CAM_VDIG1";
	qcom,sensor-position = <1>;
	clocks = <&clock_mmss MCLK1_CLK_SRC>,
		<&clock_mmss MMSS_CAMSS_MCLK1_CLK>;
};
